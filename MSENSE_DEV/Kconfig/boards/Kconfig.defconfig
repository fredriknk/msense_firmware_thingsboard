## MSENSE_DEV/Kconfig/boards/Kconfig.defconfig
```kconfig
# Load Zephyr board defconfig descriptions.
osource "C:/Users/fnk/Documents/GITHUB/nrfboards/boards/arm/msensedk/Kconfig.defconfig"
```

## MSENSE_MQTT_FULL/mcuboot/Kconfig/boards/Kconfig.msensedk
```kconfig
# Load board Kconfig descriptions.
osource "C:/Users/fnk/Documents/GITHUB/nrfboards/boards/arm/msensedk/Kconfig.msensedk"
```

## MSENSE_MQTT_MIN_WLOCATION/Kconfig/boards/Kconfig
```kconfig
# Load Zephyr board Kconfig descriptions.
osource "C:/Users/fnk/Documents/GITHUB/nrfboards/boards/arm/msensedk/Kconfig"
```

## Msense_ORG_MQTT_MIN/mcuboot/Kconfig/boards/Kconfig.sysbuild
```kconfig
# Load Sysbuild board Kconfig descriptions.
osource "C:/Users/fnk/Documents/GITHUB/nrfboards/boards/arm/msensedk/Kconfig.sysbuild"
```

## NRF_DK_TEST/Kconfig/Kconfig.shield
```kconfig
osource "C:/Users/fnk/Documents/GITHUB/nrfboards/boards/shields/*/Kconfig.shield"
osource "C:/ncs/workspace_1/asset_tracker_v2_devkit/boards/shields/*/Kconfig.shield"
osource "C:/ncs/workspace_1/nrf_cloudMS290/boards/shields/*/Kconfig.shield"
osource "C:/ncs/workspace_1/aws_iot_2/boards/shields/*/Kconfig.shield"
osource "C:/ncs/workspace_1/coap_client_1/boards/shields/*/Kconfig.shield"
osource "C:/ncs/v2.9.0/nrf/boards/shields/*/Kconfig.shield"
```

## boards/ardufox_nrf9160_ns.conf
```kconfig
#
# Copyright (c) 2021 Nordic Semiconductor ASA
#
# SPDX-License-Identifier: LicenseRef-Nordic-5-Clause
#

# Configuration file for Arduboard.
# This file is merged with prj.conf in the application folder, and options
# set here will take precedence if they are present in both files.

# Configuration related to external sensors.
CONFIG_SENSOR=y
CONFIG_I2C=n

# BME680 - Temperature and humidity sensor.
CONFIG_BME680=n

# Disable MCUboot DFU -- incompatible with static partitions
CONFIG_SECURE_BOOT=n
CONFIG_BUILD_S1_VARIANT=n

CONFIG_NRF_CLOUD_CLIENT_ID_PREFIX="afox-"
CONFIG_NRF_CLOUD_CLIENT_ID_SRC_IMEI=y

# Location Services configuration
CONFIG_LOCATION=y
CONFIG_LOCATION_METHOD_GNSS=y
CONFIG_LOCATION_METHOD_CELLULAR=y
CONFIG_NRF_CLOUD_AGNSS=n
CONFIG_NRF_CLOUD_LOCATION=y
CONFIG_MODEM_INFO=y
CONFIG_MODEM_INFO_ADD_NETWORK=y
CONFIG_NRF_CLOUD_PGPS=n
CONFIG_NRF_CLOUD_PGPS_REPLACEMENT_THRESHOLD=4
CONFIG_NRF_CLOUD_PGPS_REQUEST_UPON_INIT=y
```
